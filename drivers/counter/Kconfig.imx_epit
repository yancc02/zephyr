## drivers/counter/Kconfig.imx_epit
```kconfig
# Kconfig.imx_epit - IMX EPIT configuration options
#
# Copyright (c) 2018, NXP
#
# SPDX-License-Identifier: Apache-2.0
#

config TIMER_IMX_EPIT
	bool "IMX EPIT driver"
	depends on COUNTER && HAS_IMX_EPIT
	help
	  Enable the IMX EPIT driver.

if TIMER_IMX_EPIT

config TIMER_IMX_EPIT_1
	bool "Timer 1"
	help
	  Enable Timer 1.

config TIMER_IMX_EPIT_2
	bool "Timer 2"
	help
	  Enable Timer 2.

endif # TIMER_IMX_EPIT
```

## samples/epit/sample.yaml
```yaml
sample:
    description: i.MX EPIT timer sample
    name: i.MX EPIT timer sample
tests:
    test:
        build_only: true
        filter: CONFIG_SOC_IMX
        platform_whitelist: udoo_neo_full_m4
        tags: samples
```

## soc/arm/nxp_imx/mcimx6x_m4/Kconfig.defconfig.mcimx6x_m4
```kconfig
# Kconfig - i.MX 6SoloX
#
# Copyright (c) 2018, NXP
#
# SPDX-License-Identifier: Apache-2.0
#

if SOC_MCIMX6X_M4

config SOC
	string
	default "mcimx6x"

if CLOCK_CONTROL

config CLOCK_CONTROL_IMX_CCM
	def_bool y

endif # CLOCK_CONTROL

if GPIO

config GPIO_IMX
	def_bool y

endif # GPIO

if SERIAL

config UART_IMX
	def_bool y

endif # SERIAL

if IPM

config IPM_IMX
	def_bool y

endif # IPM

if COUNTER

config TIMER_IMX_EPIT
	def_bool y

endif # COUNTER

endif # SOC_MCIMX6X_M4
```
